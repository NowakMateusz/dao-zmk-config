## config/boards/shields/corne/Kconfig.board
```kconfig
# Corne board configuration

# Copyright (c) 2021 Rafael Yumagulov
# SPDX-License-Identifier: MIT

config BOARD_CORNE_LEFT
	bool "corne_left"
	depends on SOC_NRF52840_QIAA

config BOARD_CORNE_RIGHT
	bool "corne_right"
	depends on SOC_NRF52840_QIAA
```

## config/boards/shields/corne/Kconfig.defconfig
```kconfig
# Copyright (c) 2021 Rafael Yumagulov
# SPDX-License-Identifier: MIT

if SHIELD_CORNE_LEFT

	config ZMK_KEYBOARD_NAME
	default "PIT-Click"

    config ZMK_SPLIT_BLE_ROLE_CENTRAL
	default y

endif # SHIELD_CORNE_LEFT

if SHIELD_CORNE_LEFT || SHIELD_CORNE_RIGHT

config BOARD
	default "corne"

config ZMK_SPLIT
	default y

config BT_CTLR

	default BT

if USB

config USB_NRFX
	default y

config USB_DEVICE_STACK
	default y

endif # USB

endif # SHIELD_CORNE_LEFT || SHIELD_CORNE_RIGHT
```

## config/boards/shields/dao/Kconfig.defconfig
```kconfig
# Copyright (c) 2021 Rafael Yumagulov
# SPDX-License-Identifier: MIT

if SHIELD_DAO_LEFT

	config ZMK_KEYBOARD_NAME
	default "PIT-Click"

    config ZMK_SPLIT_BLE_ROLE_CENTRAL
	default y

endif # SHIELD_DAO_LEFT

if SHIELD_DAO_LEFT || SHIELD_DAO_RIGHT

config BOARD
	default "dao"

config ZMK_SPLIT
	default y

config BT_CTLR

	default BT

if USB

config USB_NRFX
	default y

config USB_DEVICE_STACK
	default y

endif # USB

endif # SHIELD_DAO_LEFT || SHIELD_DAO_RIGHT
```

## config/boards/shields/dao/Kconfig.shield
```kconfig
config SHIELD_DAO_LEFT
    def_bool $(shields_list_contains,dao_left)

config SHIELD_DAO_RIGHT
    def_bool $(shields_list_contains,dao_right)
```
